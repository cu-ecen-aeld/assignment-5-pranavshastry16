## base_external/Config.in
```kconfig
menu "AESD External Packages"
source "$BR2_EXTERNAL_project_base_PATH/package/Config.in"
endmenu
```

## base_external/package/ldd/Config.in
```kconfig
config BR2_PACKAGE_LDD
	bool "ldd"
	help
	  Linux Device Drivers (ldd3) out-of-tree kernel modules.
	  Builds and installs misc-modules and scull from assignment 7 repo.
```
